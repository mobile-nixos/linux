## Documentation/devicetree/bindings/display/panel/sitronix,st7703.yaml
```yaml
# SPDX-License-Identifier: (GPL-2.0-only OR BSD-2-Clause)
%YAML 1.2
---
$id: http://devicetree.org/schemas/display/panel/sitronix,st7703.yaml#
$schema: http://devicetree.org/meta-schemas/core.yaml#

title: Sitronix ST7703 MIPI DSI panel

maintainers:
  - Icenowy Zheng <icenowy@aosc.io>
  - Ondrej Jirman <megous@megous.com>

allOf:
  - $ref: panel-common.yaml#

properties:
  compatible:
    items:
      - enum:
        - xingbangda,xbd599
      - const: sitronix,st7703

  reg:
    description: DSI virtual channel used by that screen
    maxItems: 1

  vcc-supply:
    description: regulator that supplies the VCC voltage

  iovcc-supply:
    description: regulator that supplies the IOVCC voltage

  reset-gpios: true

  backlight: true

required:
  - compatible
  - reg
  - vcc-supply
  - iovcc-supply
  - reset-gpios

additionalProperties: false

examples:
  - |
    #include <dt-bindings/gpio/gpio.h>

    dsi {
        #address-cells = <1>;
        #size-cells = <0>;

        panel@0 {
            compatible = "xingbangda,xbd599", "sitronix,st7703";
            reg = <0>;
            reset-gpios = <&pio 3 24 GPIO_ACTIVE_HIGH>; /* LCD-RST: PD24 */
            iovcc-supply = <&reg_dldo2>;
            vcc-supply = <&reg_ldo_io0>;
            backlight = <&backlight>;
        };
    };
```

## Kconfig
```kconfig
#
# For a description of the syntax of this configuration file,
# see Documentation/kbuild/kconfig-language.txt.
#
mainmenu "Linux/$ARCH $KERNELVERSION Kernel Configuration"

config SRCARCH
	string
	option env="SRCARCH"
	
##lvwenkang@wind-mobi.com 20161013 begin	  
config	WIND_ASUS_DEMAND_SUPPORT
	bool "WIND_ASUS_DEMAND_SUPPORT"
	default n
	help
	  This macro definition just use ASUS
##lvwenkang@wind-mobi.com 20161013 end

##zhenglihong@wind-mobi.com 20170207 begin	  
config	WIND_DEF_PRO_E266L
	bool "WIND_DEF_PRO_E266L"
	default n
	help
	  This macro definition just use E266L
##zhenglihong@wind-mobi.com 20170207 end
##zhenglihong@wind-mobi.com 20170207 begin	  
config	WIND_DEF_PRO_E267L
	bool "WIND_DEF_PRO_E267L"
	default n
	help
	  This macro definition just use E267L
##zhenglihong@wind-mobi.com 20170207 end


##liukangping@wind-mobi.com 20170207 begin	  
config	WIND_DEF_PRO_E260L
	bool "WIND_DEF_PRO_E260L"
	default n
	help
	  This macro definition just use E260L
##liukangping@wind-mobi.com 20170207 end

##wangbing@wind-mobi.com 20170901 begin
config	WIND_DEF_PRO_E262L
	bool "WIND_DEF_PRO_E262L"
	default n
	help
	  This macro definition just use E262L
##wangbing@wind-mobi.com 20170901 end

source "arch/$SRCARCH/Kconfig"
```

## drivers/input/touchscreen/mediatek/Kconfig
```kconfig
#
# Touchscreen driver configuration
#
menuconfig INPUT_TOUCHSCREEN
	bool "Touchscreens"
	help
	  Say Y here, and a list of supported touchscreens will be displayed.
	  This option doesn't affect the kernel.

	  If unsure, say Y.

if INPUT_TOUCHSCREEN

config TOUCHSCREEN_MTK
	tristate "MediaTek Touch Panel Driver"
	default n
	help
	  Say Y here if you have MediaTek touch panel.

	  If unsure, say N.

	  To compile this dirver as a module, choose M here: the
	  module will be called.

source "drivers/input/touchscreen/mediatek/GT1151/Kconfig"


config TOUCHSCREEN_MTK_GT1151TB
	bool "GT1151 for Mediatek package"
	default n
	help
	  Say Y here if you have GT1151 touch panel.

	  If unsure, say N.

	  To compile this dirver as a module, choose M here: the
	  module will be called.

source "drivers/input/touchscreen/mediatek/GT1151TB/Kconfig"

config TOUCHSCREEN_MTK_GT928
	tristate "GT928 Touchscreen"
	help
	  Say Y here if you have Goodix GT928 touchscreen,
	  connected to your system.
	  If unsure, say N.
	  To compile this driver as a module, choose M here.


config TOUCHSCREEN_MTK_GT9XXTB_HN_NEW
	bool "GT9XXTB hotknot new driver for Mediatek package"
	default n
	help
	  This is new driver for goodix GT9XX series touch screen.
	  This driver upgrade FW with request_firmware method.
	  Say Y here if you use gt9xx series new touch driver.
	  If unsure, say N.

source "drivers/input/touchscreen/mediatek/gt9xxtb_hn_new/Kconfig"

config TOUCHSCREEN_MTK_GT9XX_HOTKNOT
	bool "GT9XX hotknot for Mediatek package"
	default n
	help
	  Say Y here if you have GT9XX hotknot touch panel.

	  If unsure, say N.

	  To compile this dirver as a module, choose M here: the
	  module will be called.

source "drivers/input/touchscreen/mediatek/GT9XX_hotknot/Kconfig"

config TOUCHSCREEN_MTK_GT9XX_HOTKNOT_PHONE
	bool "GT9XX hotknot phone for Mediatek package"
	default n
	help
	  Say Y here if you have GT9XX hotknot phone touch panel.

	  If unsure, say N.

	  To compile this dirver as a module, choose M here: the
	  module will be called.

source "drivers/input/touchscreen/mediatek/GT9XX_hotknot_phone/Kconfig"

config TOUCHSCREEN_MTK_SYNAPTICS_I2C_RMI4
	tristate "Synaptics DSX I2C touchscreen"
	depends on I2C
	help
	  Say Y here if you have a Synaptics DSX I2C touchscreen
	  connected to your system.

	  If unsure, say N.

	  To compile this driver as a module, choose M here: the
	  module will be called synaptics_i2c_rmi4.

source "drivers/input/touchscreen/mediatek/synaptics_i2c_rmi4/Kconfig"

config TOUCHSCREEN_MTK_GT910
	bool "GT910 for Mediatek package"
	default n
	help
	  Say Y here if you have GT910 touch panel.

	  If unsure, say N.

	  To compile this dirver as a module, choose M here: the
	  module will be called.

source "drivers/input/touchscreen/mediatek/GT910/Kconfig"

config TOUCHSCREEN_MTK_GT9XX_HOTKNOT_SCP
	bool "GT9XX_HOTKNOT_SCP for Mediatek package"
	default n
	help
	  Say Y here if you have GT9XX_HOTKNOT_SCP touch panel.
	  If unsure, say N.

	  To compile this dirver as a module, choose M here: the
	  module will be called.

source "drivers/input/touchscreen/mediatek/GT9XX_hotknot_scp/Kconfig"

config TOUCHSCREEN_MTK_FT5X0X
	bool "FT5X0X for Mediatek package"
	default n
	help
	  Say Y here if you have FT5X0X touch panel.
	  If unsure, say N.

	  To compile this dirver as a module, choose M here: the
	  module will be called.

source "drivers/input/touchscreen/mediatek/ft5x0x/Kconfig"


config TOUCHSCREEN_MTK_FT6336S
	bool "FT633S for Mediatek package"
	default n
	help
	  Say Y here if you have FT6336S touch panel.
	  If unsure, say N.

	  To compile this dirver as a module, choose M here: the
	  module will be called.

config TOUCHSCREEN_MTK_MSG2238A
	bool "MSG2238A for Mediatek package"
	default n
	help
	  Say Y here if you have MSG2238A touch panel.
	  If unsure, say N.

	  To compile this dirver as a module, choose M here: the
	  module will be called.

config TOUCHSCREEN_MTK_SYNAPTICS_3320_50
	bool "Synaptics 5.0inch for Mediatek package"
	default n

config TOUCHSCREEN_UNIFIED_DRIVER_4
	bool "LGE Unified driver Ver4.0"
	depends on I2C
	default n
	help
	  Say Y here if you use lge unified driver ver4.0
	  if unsure, say N
	  To compile this dirver as a module, choose M here: the
	  module will be called.

config TOUCHSCREEN_LGE_MIT300
	bool "Melfas MIT-300 based on LGE Touch Core driver"
	depends on I2C && TOUCHSCREEN_UNIFIED_DRIVER_4
	default n
	help
	  Say Y here if you have a Mefas MIT-300 I2C touchscreen
	  connected to your system.
	  To compile this dirver as a module, choose M here: the
	  module will be called.

config TOUCHSCREEN_LGE_MIT300_M4
	bool "Melfas MIT-300 based on LGE Touch Core driver"
	depends on I2C && TOUCHSCREEN_UNIFIED_DRIVER_4
	default n
	help
	  Say Y here if you have a Mefas MIT-300 I2C touchscreen
	  connected to your system.
	  To compile this dirver as a module, choose M here: the
	  module will be called.

config TOUCHSCREEN_LGE_FT8707
	bool "FT8707 based on LGE Touch Core driver"
	depends on I2C && TOUCHSCREEN_UNIFIED_DRIVER_4
	default n
	help
	  Say Y here if you have a FT8707 I2C touchscreen
	  connected to your system.
	  To compile this dirver as a module, choose M here: the
	  module will be called.

#hebiao@wind-mobi.com 20161108 begin
config TOUCHSCREEN_FT3427
	bool "focalTech touchpanel ft8606 series"
	depends on I2C
	help
	  Say Y here if you have a focalTech ft8606 touchscreen.
	  ft8606 controllers are multi touch controllers which can
	  report 10 touches at a time.

          If unsure, say N.

source "drivers/input/touchscreen/mediatek/ft3427/Kconfig"	  

config TOUCHSCREEN_HIMAX_HX852xES
	bool "Himax touchpanel HX852xES series"
	depends on I2C
	help
	  Say Y here if you have a Himax HX852xES touchscreen.
	  HX852xES controllers are multi touch controllers which can
	  report 10 touches at a time.

          If unsure, say N.

source "drivers/input/touchscreen/mediatek/hx852xes/Kconfig"	            	  
#hebiao@wind-mobi.com 20161109 end	  
	
#ranyanhao@wind-mobi.com 20160928 begin
config TOUCHSCREEN_SYNAPTICSS2716
	bool "Synaptics touchpanel S2716 series"
	depends on I2C
	help
	  Say Y here if you have a Synaptics S2716 touchscreen.
	  S2716 controllers are multi touch controllers which can
	  report 10 touches at a time.

          If unsure, say N.

source "drivers/input/touchscreen/mediatek/synapticss2716/Kconfig"	             	  
#ranyanhao@wind-mobi.com 20160928 end


#lihaiyan@wind-mobi.com 20170114 begin
config TOUCHSCREEN_MTK_MSG5846
	bool "Synaptics touchpanel MSG5846 "
	depends on I2C
	help
	  Say Y here if you have a  MSG5846 touchscreen.


source "drivers/input/touchscreen/mediatek/MSG5846/Kconfig"	    

##liukangping begin
config TOUCHSCREEN_MTK_MSG2836
	bool "Synaptics touchpanel msg2836 "
	depends on I2C
	help
	  Say Y here if you have a  MSG5846 touchscreen.
source "drivers/input/touchscreen/mediatek/msg2836/Kconfig"	  
##liukangping end

##qiangang begin
config TOUCHSCREEN_MTK_GT917
	bool "goodix touchpanel gt917 "
	depends on I2C
	help
	  Say Y here if you have a  GT917 touchscreen.
source "drivers/input/touchscreen/mediatek/gt917/Kconfig"	  
##qiangang end


config TOUCHSCREEN_FT3427_E266L
	bool "focalTech touchpanel ft8606 series"
	depends on I2C
	help
	  Say Y here if you have a focalTech ft8606 touchscreen.
	  ft8606 controllers are multi touch controllers which can
	  report 10 touches at a time.

          If unsure, say N.


source "drivers/input/touchscreen/mediatek/focaltech_touch_ft3427/Kconfig"
source "drivers/input/touchscreen/mediatek/ft3427_E266L_new/Kconfig"        # wangbing@wind-mobi.com 20170502

#lihaiyan@wind-mobi.com 20170114 end

#wangjun@wind-mobi.com 20170601 begind 
config TOUCHSCREEN_HX83102_HLT_E266L
	bool "Himax touchpanel HX83102 "
	depends on I2C
	help
	  Say Y here if you have a  HX83102 touchscreen.


source "drivers/input/touchscreen/mediatek/HX83102/Kconfig"	    

#wangjun@wind-mobi.com 20170601 end 

#wangjun@wind-mobi.com 20170922 begind 
config WIND_DEF_LCM_COMPATIBLE
	bool "LCM/TP Size Compatible "
	default n
	help
	  For LCM Different Size Compatible

#wangjun@wind-mobi.com 20170922 end 

endif
```

## drivers/input/touchscreen/mediatek/hx852xes/Kconfig
```kconfig
#ranyanhao@wind-mobi.com 20160215 begin
#
# Himax Touchscreen driver configuration
#

config TOUCHSCREEN_HIMAX_I2C
        tristate "HIMAX HX852xES serious i2c touchscreen"
		depends on TOUCHSCREEN_HIMAX_HX852xES
		help
		This enables support for HIMAX HX852xES over I2C based touchscreens.

#config TOUCHSCREEN_HIMAX_DEBUG
#        tristate "HIMAX debug function"
#		depends on TOUCHSCREEN_HIMAX_I2C
#		help
#		This enables support for HIMAX debug function.
config HMX_DB
	tristate "HIMAX driver test over Dragon Board"
	depends on TOUCHSCREEN_HIMAX_I2C
	help
	  This enables support for HIMAX driver test over Dragon Board.
config WIND_SMWP_ENABLE
        tristate "HIMAX HX852xES gesture enbale"
		depends on TOUCHSCREEN_HIMAX_HX852xES
		help
		This enables support for HIMAX HX852xES gesture.
#ranyanhao@wind-mobi.com 20160215 end
```

## drivers/misc/mediatek/accelerometer/KXTJ2_1009-new/Kconfig
```kconfig
#ranyanhao@wind-mobi.com 20151230 begin	  
config MTK_KXTJ2_1009_NEW
	bool "CONFIG_MTK_KXTJ2_1009_NEW"
	default n
	help 
		Select KXTJ2_1009_NEW driver y or n
#ranyanhao@wind-mobi.com 20151230 begin
```

## drivers/misc/mediatek/accelerometer/lsm6ds3/Kconfig
```kconfig
config MTK_LSM6DS3
	bool "ST LSM6DS3 accelerometer driver for MediaTek package"
	default n
	help
	  To claim the support of LSM6DS3 accelerometer driver.
	  If this option is set,
	  it will support LSM6DS3 Accelerometer.
	  If unsure,say N.
	  

config CUSTOM_KERNEL_SIGNIFICANT_MOTION_SENSOR    
	bool "CUSTOM_KERNEL_SIGNIFICANT_MOTION_SENSOR"
	default n
	help
	  Kernel space sigificant motion sensor driver.
	  If this option is set,
	  it will support LSM6DS3 Accelerometer.
	  If unsure,say N.
```

## drivers/misc/mediatek/accelerometer/n2dm/Kconfig
```kconfig
#hebiao@wind-mobi.com 2015112 begin	  
config MTK_N2DM
	bool "CONFIG_MTK_N2DM"
	default n
	help 
		Select N2DM driver y or n
#hebiao@wind-mobi.com 2015112 end
```

## drivers/misc/mediatek/alsps/epl259x/Kconfig
```kconfig
#ranyanhao@wind-mobi.com 20151230 begin
config MTK_EPL259X
	bool "CONFIG_MTK_EPL259X"
	default n
	help
		Select epl259x driver y or n
#ranyanhao@wind-mobi.com 20151230 end
```

## drivers/misc/mediatek/alsps/stk3x1x/Kconfig
```kconfig
# wangbing@wind-mobi.com 20170421 begin
config MTK_STK3X1X
	bool "stk3x1x for MediaTek package"
	default n
	help
	It support different type sensor
	in this platform. If this option
	is set, it will support ambient
	and light sensor STK3X1X.
# wangbing@wind-mobi.com 20170421 end
```

## drivers/misc/mediatek/fingerprint/Kconfig
```kconfig
#
#Fingerprint
#
menu "Finger support"
	depends on !UML

config MTK_FINGERPRINT
	tristate "Mediatek Fingerprint"
	default y
	---help---
	Fingerprint mtk driver enable/disable in the kernel.
	Say Y here if you want to use mediatek fingerprint driver,
	fingerprint driver will support fingerprint function in REE,
	it supports Goodix's GF316M/GF318M/GF3118M/GF518M/GF5118M/GF516M/GF816M/GF3208/GF5216... device.

if MTK_FINGERPRINT

config FPSENSOR_FINGERPRINT
	bool "FPSENSOR_FINGERPRINT"
	default n
	---help---
	LeaderCore Fingerprint chip TEE driver

config GOODIX_FINGERPRINT
	bool "GOODIX_FINGERPRINT"
	default n
	---help---
	Goodix Fingerprint chip GF316M/GF318M/GF3118M/GF518M/GF5118M/GF516M/GF816M/GF3208/GF5216 TEE driver

config GOODIX_SENSOR_TYPE
	string "SENSOR_TYPE"
	default "GF516M"
	---help---
	Must input sensor type, or default is GF316M GF318M GF3118M GF518M GF5118M GF516M GF816M GF3208 GF5216
##liukangping 20170112 begin		
config SUNWAVE_FINGERPRINT
	bool "SUNWAVE_FINGERPRINT"
	default n
	---help---
	Sunwave Fingerprint chip sw9562 TEE driver
##liukangping 20170112 begin	

##zhangkaiyuan@wind-mobi.com 20170914 begin		
config MICROARRAY_FINGERPRINT
	bool "MICROARRAY_FINGERPRINT"
	default n
	---help---
	Microarray Fingerprint chip TEE driver
##zhangkaiyuan@wind-mobi.com 20170914 end

endif
endmenu
```

## drivers/misc/mediatek/flashlight/Kconfig
```kconfig
config MTK_FLASHLIGHT
  tristate CONFIG_MTK_FLASHLIGHT
  default n
  help
    CONFIG_MTK_FLASHLIGHT

config CUSTOM_KERNEL_FLASHLIGHT
        string "CUSTOM_KERNEL_FLASHLIGHT"
        help
          Kernel space cameara flashlight driver. You can use this driver
          choose cameara flashlight type.

## zhaozhensen@wind-mobi.com 20161220 begin
config WIND_ASUS_FLASHLIGHT_LOW_BAT_ON
	bool "WIND_ASUS_FLASHLIGHT_LOW_BAT_ON"
	default n
	help
		This is an option for ASUS to control flashlight ON or OFF in low power
## zhaozhensen@wind-mobi.com 20161220 end

config MTK_FLASHLIGHT_USE_MODULE
	bool "Mediatek flashlight driver build as module"
	default n
	help
	  Say Y here if you want to build flashlight driver as xxx.ko.

	  If unsure, say N.

	  To compile this dirver as a module,
	  It will be called by insmod xxx.ko in init.rc.

source "drivers/misc/mediatek/flashlight/richtek/Kconfig"
```
