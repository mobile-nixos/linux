## drivers/misc/mediatek/imgsensor/Kconfig
```kconfig
config MTK_IMGSENSOR
	tristate "enable MTK cam driver"
	default n
	help
	  It support different sensor.
          If this option is set to m,
          it will build module.

config MTK_CAM_MAX_NUMBER_OF_CAMERA
	int "max number of camera supported"
	default 2
	help
	  max number of camera supported

config MTK_EFUSE_DOWNGRADE
	bool "a variant of downgrade chip"
	default n
	help
	  a variant of downgrade chip

#dingyisheng@wind-mobi.com 20170821 begin
config WIND_CAM_SINGLE_LDO_SUPPORT
	bool "WIND_CAM_SINGLE_LDO_SUPPORT"
	default n
	help
	  ldo number of camera supported in ASUS E260L project
  
config WIND_CAM_DOUBLE_LDO_SUPPORT
	bool "WIND_CAM_DOUBLE_LDO_SUPPORT"
	default n
	help
	  ldo number of camera supported in ASUS E262L project
	  
#dingyisheng@wind-mobi.com 20170821 end
```

## drivers/misc/mediatek/magnetometer/af7133-new/Kconfig
```kconfig
config MTK_AF7133_NEW
	bool "AF8133I for MediaTek package"
	default n
	help
	  It support different magnetometer sensor.
          If this option is set,
	  it will support
          AF8133I magnetometer.
```

## drivers/misc/mediatek/magnetometer/qmcX983/Kconfig
```kconfig
## ranyanhao@wind-mobi.com 20161105 begin
config MTK_QMCX983
	bool "QMCX983 for MediaTek package"
	default n
	help
	  It support different magnetometer sensor.
          If this option is set,
	  it will support
          QMCX983 magnetometer.
		  
config CUSTOM_KERNEL_SOFT_GYROSCOPE
	bool "CUSTOM_KERNEL_SOFT_GYROSCOPE"
	default n
	help
		y mean support soft_gyroscope
		n mean not support soft_gyroscope
## ranyanhao@wind-mobi.com 20161105 end
```

## drivers/misc/mediatek/otg_chg_ctl/Kconfig
```kconfig
#yutao@wind-mobi.com 20160601 begin
config MTK_OTG_CHG_CTL
  bool "CONFIG_MTK_OTG_CHG_CTL"
  default n
  help
    CONFIG_MTK_OTG_CHG_CTL
#yutao@wind-mobi.com 20160601 end
```

## drivers/misc/mediatek/sensors-1.0/alsps/pa22a/Kconfig
```kconfig
# wangjun@wind-mobi.com 20170725 begin
config MTK_PA22A
	bool "pa22a for MediaTek package"
	default n
	help
	It support different type sensor
	in this platform. If this option
	is set, it will support ambient
	and light sensor PA22A.
# wangjun@wind-mobi.com 20170725 end
```

## drivers/misc/mediatek/sensors-1.0/alsps/tl5601c/Kconfig
```kconfig
config MTK_TL5601C
	bool "tl5601c for MediaTek package"
	default n
	help
	It support different type sensor
	in this platform. If this option
	is set, it will support ambient
	and light sensor tl5601c.
```

## drivers/misc/mediatek/sensors-1.0/magnetometer/afx133/Kconfig
```kconfig
config MTK_AFx133
	bool "AFx133 for MediaTek package"
	default n
	help
	  It support different magnetometer sensor.
          If this option is set,
	  it will support
          AFx133 magnetometer.
```

## drivers/misc/mediatek/usbsw/Kconfig
```kconfig
#yutao@wind-mobi.com 20160601 begin
config MTK_USBSW
  bool "CONFIG_MTK_USBSW"
  default n
  help
    CONFIG_MTK_USBSW
#yutao@wind-mobi.com 20160601 end
```

## drivers/misc/mediatek/vibrator/Kconfig
```kconfig
config MTK_VIBRATOR
    tristate "MediaTek Vibrator driver"
    default n
	---help---
	Vibrator driver support for MediaTek SOC.
	You can customize the vibrate strength and lowest vibrate time.
	If you want to use MediaTek Vibrator driver, say Y or M here.
	If unsure, say N.
##zhangkaiyuan@wind-mobi.com 20170301 begin 
config HAS_VIBRATION_INTENSITY
  bool "CONFIG_HAS_VIBRATION_INTENSITY"
  default n
  help
    CONFIG_HAS_VIBRATION_INTENSITY
##zhangkaiyuan@wind-mobi.com 20170301 end
```

## drivers/misc/mediatek/wind_device_info/Kconfig
```kconfig
#ranyanhao@wind-mobi.com 20160104 begin
config WIND_DEVICE_INFO
	bool "CONFIG_WIND_DEVICE_INFO"
	default n
	help
		Select y or n
#ranyanhao@wind-mobi.com 20160104 end
```

## drivers/mmc/core/Kconfig
```kconfig
#
# MMC core configuration
#

config MMC_CLKGATE
	bool "MMC host clock gating"
	help
	  This will attempt to aggressively gate the clock to the MMC card.
	  This is done to save power due to gating off the logic and bus
	  noise when the MMC card is not in use. Your host driver has to
	  support handling this in order for it to be of any use.

	  If unsure, say N.

config MMC_EMBEDDED_SDIO
	boolean "MMC embedded SDIO device support (EXPERIMENTAL)"
	help
	  If you say Y here, support will be added for embedded SDIO
	  devices which do not contain the necessary enumeration
	  support in hardware to be properly detected.

config MMC_PARANOID_SD_INIT
	bool "Enable paranoid SD card initialization (EXPERIMENTAL)"
	help
	  If you say Y here, the MMC layer will be extra paranoid
	  about re-trying SD init requests. This can be a useful
	  work-around for buggy controllers and hardware. Enable
	  if you are experiencing issues with SD detection.

config ASUS_GET_EMMC_TOTAL_SIZE
	bool "Enable ASUS_GET_EMMC_TOTAL_SIZE"
	help
	  If you say Y here, the MMC layer will be extra paranoid
	  about re-trying SD init requests. This can be a useful
	  work-around for buggy controllers and hardware. Enable
	  if you are experiencing issues with SD detection.

# wangjun@wind-mobi.com 20170821 begin
config ASUS_EMMC_NODE
	bool "Enable ASUS_EMMC_NODE"
	help
	  If you say Y here, they will creat emmc_total_size,
	  emmc_health, emmc_life_A, emmc_life_B node at emmc
	  dir for ASUS storage request
# wangjun@wind-mobi.com 20170821 end
```
