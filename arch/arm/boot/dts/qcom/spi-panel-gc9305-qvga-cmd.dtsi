/* Copyright (c) 2017, The Linux Foundation. All rights reserved.
 *
 * This program is free software; you can redistribute it and/or modify
 * it under the terms of the GNU General Public License version 2 and
 * only version 2 as published by the Free Software Foundation.
 *
 * This program is distributed in the hope that it will be useful,
 * but WITHOUT ANY WARRANTY; without even the implied warranty of
 * MERCHANTABILITY or FITNESS FOR A PARTICULAR PURPOSE.  See the
 * GNU General Public License for more details.
 */

&mdss_mdp {
	spi_gc9305_qvga_cmd: qcom,mdss_spi_gc9305_qvga_cmd {
		qcom,mdss-spi-panel-name = "gc9305 qvga command mode spi panel";
		qcom,mdss-spi-panel-destination = "display_1";
		qcom,mdss-spi-panel-controller = <&mdss_spi>;
		qcom,mdss-spi-panel-framerate = <30>;
		qcom,mdss-spi-panel-width = <240>;
		qcom,mdss-spi-panel-height = <320>;
		qcom,mdss-spi-h-front-porch = <12>;
		qcom,mdss-spi-h-back-porch = <12>;
		qcom,mdss-spi-h-pulse-width = <4>;
		qcom,mdss-spi-v-back-porch = <10>;
		qcom,mdss-spi-v-front-porch = <8>;
		qcom,mdss-spi-v-pulse-width = <2>;
		qcom,mdss-spi-h-left-border = <0>;
		qcom,mdss-spi-h-right-border = <0>;
		qcom,mdss-spi-v-top-border = <0>;
		qcom,mdss-spi-v-bottom-border = <0>;
		qcom,mdss-spi-bpp = <16>;
		qcom,mdss-spi-on-command = [00 02 36 00
			00 02 3A 05
			00 02 35 00
			00 06 B2 0C 0C 00 33 33
			00 02 B7 35
			00 02 BB 35
			00 02 C0 2C
			00 02 C2 01
			00 02 C3 11
			00 02 C4 20
			00 02 C6 12
			00 03 44 00 00
			00 03 D0 A4 A1
			00 0F E0 D0 00 06 0D 0F 2A 39 44 49 0B 16 15 1A 1D
			00 0F E1 D0 00 06 0D 0F 2A 37 44 49 0B 17 15 1B 1E
			00 05 2A 00 00 00 EF
			00 05 2B 00 00 01 3F
			00 01 2C
			00 07 F0 02 02 00 08 0C 10
			00 07 F1 01 00 00 14 1D 0E
			00 07 F2 10 09 37 04 04 48
			00 07 F3 10 0B 3F 05 05 4E
			00 07 F4 0D 19 17 1D 1E 0F
			00 07 F5 06 12 13 1A 1B 0F
			78 01 11
			00 01 29
			00 01 2C];
		qcom,mdss-spi-off-command = [00 01 28
				78 01 10];
		qcom,mdss-brightness-max-level = <255>;
		qcom,mdss-spi-bl-min-level = <1>;
		qcom,mdss-spi-bl-max-level = <255>;
		qcom,mdss-spi-reset-sequence = <1 10>, <0 2>, <1 10>;
	};
};
